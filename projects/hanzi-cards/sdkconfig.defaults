## projects/hanzi-cards/sdkconfig.defaults
```kconfig
# --- 目标芯片 ---
CONFIG_IDF_TARGET="esp32c3"
# 注:ESP32-C3 无 PSRAM,故不设 CONFIG_SPIRAM。

# --- Flash ---
# FoloToy AI Passport 当前产品/固件基线使用 8MB Flash。
CONFIG_ESPTOOLPY_FLASHSIZE_8MB=y
# 固定 8MB 镜像头，关闭 detect，便于 idf.py merge-bin。
CONFIG_ESPTOOLPY_HEADER_FLASHSIZE_UPDATE=n
CONFIG_PARTITION_TABLE_CUSTOM=y
CONFIG_PARTITION_TABLE_CUSTOM_FILENAME="partitions.csv"
CONFIG_PARTITION_TABLE_FILENAME="partitions.csv"

# --- 控制台:USB-Serial-JTAG(C3 原生 USB,GPIO18/19)---
# 不用 UART0:其默认 TX=GPIO21 与本板背光引脚冲突。
CONFIG_ESP_CONSOLE_USB_SERIAL_JTAG=y
CONFIG_ESP_CONSOLE_SECONDARY_NONE=y

# --- LVGL ---
CONFIG_LV_COLOR_DEPTH_16=y
CONFIG_LV_FONT_MONTSERRAT_14=y
# 卡片页只有图片、大字、短语三个对象。
CONFIG_LV_MEM_SIZE_KILOBYTES=32

# --- 系统 ---
CONFIG_FREERTOS_HZ=1000

# --- 关闭未使用的蓝牙 ---
CONFIG_BT_ENABLED=n
```

## projects/xiaozhi-deepseek/main/Kconfig.projbuild
```kconfig
menu "Xiaozhi DeepSeek AI Assistant"

    menu "AI Model Configuration (Built-in DeepSeek)"
        config XIAOZHI_MODEL_PROVIDER
            string "Model Provider Name"
            default "deepseek"
            help
                AI Model Provider name (e.g., deepseek, openai, custom).

        config XIAOZHI_DEEPSEEK_API_KEY
            string "DeepSeek API Key"
            default ""
            help
                Your DeepSeek API Key (e.g. sk-xxxxxxxxxxxxxxxxxxxxxxxxxxxxxxxx).
                When configured during development/build, the device directly uses
                this built-in key without needing any runtime configuration.

        config XIAOZHI_DEEPSEEK_BASE_URL
            string "DeepSeek API Base URL"
            default "https://api.deepseek.com/v1"
            help
                Base URL for DeepSeek API endpoint.

        config XIAOZHI_DEEPSEEK_MODEL
            string "DeepSeek Model Name"
            default "deepseek-chat"
            help
                Model identifier (e.g., deepseek-chat, deepseek-reasoner).

        config XIAOZHI_DEEPSEEK_SYSTEM_PROMPT
            string "System Prompt"
            default "你是小智，一个运行在 FoloToy AI Passport 随身卡片机上的智能语音伴侣助手。你的回答需要简明、亲切、生动，适合小屏幕显示和语音交流。"
            help
                System prompt configured for the AI assistant.

        config XIAOZHI_DEEPSEEK_TEMPERATURE
            int "Temperature (x10, e.g. 7 for 0.7)"
            default 7
            range 0 20
            help
                Sampling temperature multiplied by 10 (0 to 20, where 7 = 0.7).

        config XIAOZHI_DEEPSEEK_MAX_TOKENS
            int "Max Completion Tokens"
            default 512
            range 64 2048
            help
                Maximum number of tokens to generate in response.
    endmenu

    menu "Wi-Fi Configuration"
        config XIAOZHI_WIFI_SSID
            string "Default Wi-Fi SSID"
            default ""
            help
                Default Wi-Fi SSID for auto-connection on boot.

        config XIAOZHI_WIFI_PASSWORD
            string "Default Wi-Fi Password"
            default ""
            help
                Default Wi-Fi Password.

        config XIAOZHI_WIFI_AUTO_CONNECT
            bool "Auto-connect Wi-Fi on boot"
            default y
            help
                Automatically connect to configured Wi-Fi upon startup.
    endmenu

    menu "Audio and Voice Configuration"
        config XIAOZHI_AUDIO_DEFAULT_VOLUME
            int "Default Volume (0-100%)"
            default 75
            range 0 100
            help
                Default speaker output volume percentage.

        config XIAOZHI_AUDIO_SAMPLE_RATE
            int "Audio Sample Rate (Hz)"
            default 16000
            help
                Audio sample rate for microphone capture and playback.
    endmenu

endmenu
```
